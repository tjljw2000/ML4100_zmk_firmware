## boards/shields/cherry_ml4100/Kconfig.defconfig
```kconfig
if SHIELD_CHERRY_ML4100

config ZMK_KEYBOARD_NAME
    default "Cherry ML4100 Wireless"

endif
```

## boards/shields/cherry_ml4100/Kconfig.shield
```kconfig
# No whitespace after the comma or in your keyboard name!
config SHIELD_CHERRY_ML4100
    def_bool $(shields_list_contains,cherry_ml4100)
```

## config/west.yml
```yaml
manifest:
  remotes:
    - name: zmkfirmware
      url-base: https://github.com/zmkfirmware
    # Additional modules containing boards/shields/custom code can be listed here as well
    # See https://docs.zephyrproject.org/3.2.0/develop/west/manifest.html#projects
    - name: bluedrink9
      url-base: https://github.com/bluedrink9
  projects:
    - name: zmk
      remote: zmkfirmware
      revision: main
      import: app/west.yml
    - name: zmk-poor-mans-led-indicator
      remote: bluedrink9
      revision: main
  self:
    path: config
```
